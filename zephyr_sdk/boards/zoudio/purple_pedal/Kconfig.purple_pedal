## zephyr_sdk/boards/zoudio/purple_pedal/Kconfig.purple_pedal
```kconfig
# Copyright (c) 2024 STMicroelectronics
# SPDX-License-Identifier: Apache-2.0

config BOARD_PURPLE_PEDAL
	#select SOC_STM32G0B1XX
	select SOC_STM32G0B0XX
```

## zephyr_sdk/boards/zoudio/purple_pedal/board.yml
```yaml
board:
  name: purple_pedal
  full_name: Purple Pedal
  vendor: zoudio
  socs:
    # - name: stm32g0b1xx
    - name: stm32g0b0xx
```

## zephyr_sdk/drivers/mfd/Kconfig.sc16is7xx
```kconfig
menuconfig MFD_SC16IS7XX
	bool "SC16IS7XX multi-function device driver"
	default y
	depends on DT_HAS_NXP_SC16IS7XX_ENABLED
	# select I2C if $(dt_compat_on_bus,$(DT_COMPAT_NXP_SC16IS7XX),i2c)
	# select SPI if $(dt_compat_on_bus,$(DT_COMPAT_NXP_SC16IS7XX),spi)
	help
	  Enable the SC16IS7XX multi-function device driver.

config MFD_SC16IS7XX_INIT_PRIORITY
	int "SC16IS7XX MFD initialization priority"
	default MFD_INIT_PRIORITY
	depends on MFD_SC16IS7XX
	help
	  Multi-function device initialization priority for SC16IS7XX.

if MFD_SC16IS7XX

config MFD_SC16IS7XX_BUS_I2C
	bool "SC16IS7XX I2C bus support"
	default y
	depends on $(dt_compat_on_bus,$(DT_COMPAT_NXP_SC16IS7XX),i2c)
	depends on I2C

config MFD_SC16IS7XX_BUS_SPI
	bool "SC16IS7XX SPI bus support"
	default y
	depends on $(dt_compat_on_bus,$(DT_COMPAT_NXP_SC16IS7XX),spi)
	depends on SPI

endif # MFD_SC16IS7XX
```

## zephyr_sdk/drivers/serial/Kconfig
```kconfig
if SERIAL

# zephyr-keep-sorted-start
rsource "Kconfig.sc16is7xx"
# zephyr-keep-sorted-stop

endif # SERIAL
```

## zephyr_sdk/drivers/serial/Kconfig.sc16is7xx
```kconfig
config UART_SC16IS7XX
	bool "SC16IS7XX UART driver"
	default y
	depends on DT_HAS_NXP_SC16IS7XX_UART_ENABLED
	select MFD
	help
	  Enable the SC16IS7XX UART driver.

config UART_SC16IS7XX_INIT_PRIORITY
	int "SC16IS7XX UART initialization priority"
	default MFD_SC16IS7XX_INIT_PRIORITY
	depends on UART_SC16IS7XX
	help
	  Multi-function device initialization priority for SC16IS7XX.

if UART_SC16IS7XX

endif # SC16IS7XX
```

## zephyr_sdk/dts/bindings/mfd/nxp,sc16is7xx-common.yaml
```yaml
description: SC16IS7XX common properties

properties:
# common properties that applies at the chip level,
# properties at UART level is put into nxp,sc16is7xx-uart.yaml

#     reg-shift:
#       type: int
#       required: true
#       description: quantity to shift the register offsets by (3 for the sc16is7xx)

#     config:
#       type: int
#       required: false
#       description: |
#         Value of the configuration register

  interrupt-gpios:
     type: phandle-array
     required: false
     description: Interrupt GPIO pin (active-low open-drain)

  reset-gpios:
    type: phandle-array
    required: false
    description: Reset GPIO pin (active-low open-drain)

  clock-frequency:
    type: int
    required: true
    description: Clock frequency of SC16IS7XX

bus: nxp,sc16is7xx
```

## zephyr_sdk/dts/bindings/mfd/nxp,sc16is7xx-i2c.yaml
```yaml
description: NXP SC16IS7xx I2C to UART

compatible: "nxp,sc16is7xx"

include: ["i2c-device.yaml", "nxp,sc16is7xx-common.yaml"]

# properties:
#   reg:
#     required: true
```

## zephyr_sdk/dts/bindings/mfd/nxp,sc16is7xx-spi.yaml
```yaml
description: NXP SC16IS7xx SPI to UART

compatible: "nxp,sc16is7xx"

include: ["spi-device.yaml", "nxp,sc16is7xx-common.yaml"]
```

## zephyr_sdk/dts/bindings/serial/nxp,sc16is7xx-uart.yaml
```yaml
description: |
    sc16is7xx has one or more UART, and one or more GPIO

    Example:
    sc16is7xx@48 {
      reg = <0x48>;
      ...
      regulators {
        compatible = "nordic,sc16is7xx-uart";

        UART0 {
          /* all properties for UART0 */
        };
        UART1 {
          /* all properties for UART1 */
        };
      };
    };

compatible: "nxp,sc16is7xx-uart"

# include: base.yaml

# child-binding:
#   include:
#     - name: uart-controller.yaml
#       property-allowlist:
#         - clock-frequency
#         - current-speed
#         - hw-flow-control
#         - parity
#         - stop-bits
#         - data-bits

include: uart-controller.yaml

properties:
  channel:
    type: int
    description: |
      Sets the number of data bits.
    enum:
      - 0
      - 1

on-bus: nxp,sc16is7xx
```

## zephyr_sdk/lib/Kconfig
```kconfig
# Copyright (c) 2021 Legrand North America, LLC.
# SPDX-License-Identifier: Apache-2.0

menu "Out of tree libraries"

rsource "custom/Kconfig"

rsource "p1meter/Kconfig"

endmenu
```

## zephyr_sdk/lib/p1meter/Kconfig
```kconfig
# Copyright (c) 2021, Legrand North America, LLC.
# SPDX-License-Identifier: Apache-2.0

config P1_METER
	bool "Support for P1 meter protocol"
	help
	  This option enables the P1 meter protocol support
```

## zephyr_sdk/west.yml
```yaml
# Copyright (c) 2021 Nordic Semiconductor ASA
# SPDX-License-Identifier: Apache-2.0

manifest:
  self:
    west-commands: scripts/west-commands.yml

  remotes:
    - name: zephyrproject-rtos
      url-base: https://github.com/zephyrproject-rtos

  projects:
    - name: zephyr
      remote: zephyrproject-rtos
      revision: v4.3.0
      # revision: v4.2.1
      # revision: v4.1.0
      # revision: main
      import:
        # By using name-allowlist we can clone only the modules that are
        # strictly needed by the application.
        name-allowlist:
          - cmsis      # required by the ARM port
          - cmsis_6    # required by the ARM port for Cortex-M
          - cmsis-dsp
          - hal_espressif
          - hal_infineon
          - hal_nordic # required by the custom_plank board (Nordic based)
          - hal_stm32  # required by the nucleo_f302r8 board (STM32 based)
          - hal_ti
          - liblc3
          - libmetal
          - littlefs
          - lvgl
          - mbedtls
          - mcuboot
          - net-tools
          - open-amp
          - segger
          - tinycrypt
          - zcbor
```
