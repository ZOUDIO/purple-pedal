/* overlay created for Nucleo-F767ZI mounted on base board*/
///dts-v1/;

/ {
	example_sensor: example-sensor {
		compatible = "zephyr,example-sensor";
		input-gpios = <&gpiod 2 (GPIO_PULL_UP | GPIO_ACTIVE_LOW)>;
	};

	blink_led: blink-led {
		compatible = "blink-gpio-led";
		led-gpios = <&gpiod 13 GPIO_ACTIVE_HIGH>;
		blink-period-ms = <1000>;
	};
};